## main/Kconfig.projbuild
```kconfig
menu "OpenTherm Bridge"

config OT_IN_GPIO
    int "OpenTherm adapter input GPIO (interrupt)"
    range 0 23
    default 12
    help
        GPIO connected to the OpenTherm adapter input (interrupt-capable).

config OT_OUT_GPIO
    int "OpenTherm adapter output GPIO"
    range 0 23
    default 13
    help
        GPIO connected to the OpenTherm adapter output.

config OT_SERIAL_HARNESS
    bool "Enable OpenTherm serial harness (ot_read/ot_write/ot_cat)"
    default n
    help
        Register esp_console commands for manual OpenTherm READ/WRITE testing.
        Uses the default UART console REPL.

endmenu
```

## sdkconfig.defaults
```kconfig
CONFIG_IDF_TARGET="esp32c6"

#
# Partition Table
#
CONFIG_PARTITION_TABLE_CUSTOM=y
CONFIG_PARTITION_TABLE_CUSTOM_FILENAME="partitions.csv"
CONFIG_PARTITION_TABLE_FILENAME="partitions.csv"
CONFIG_PARTITION_TABLE_OFFSET=0x8000

#
# Wi-Fi disabled (Zigbee-only v1)
#
CONFIG_ESP_WIFI_ENABLED=n

#
# Zigbee End Device
#
CONFIG_ZB_ENABLED=y
CONFIG_ZB_ZED=y
```
